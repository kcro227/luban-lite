## application/rt-thread/helloworld/Kconfig
```kconfig
comment "LCKFB Module transplant code"

menuconfig USING_LCKFB_TRANSPLANT_CODE
    bool "Porting code using the LCKFB module"
    default n
    help
        Official Website : www.lckfb.com

# 如果使用立创开发板的模块移植代码则开启下面的选项
if USING_LCKFB_TRANSPLANT_CODE

source "application/rt-thread/helloworld/user_led/Kconfig"
# 1.69寸彩屏
source "application/rt-thread/helloworld/user-bsp/1-69-color-screen/Kconfig"

endif # 结束
```

## application/rt-thread/helloworld/user-bsp/1-69-color-screen/Kconfig
```kconfig
comment "use 1.69 inch st7789V SPI screen"
config LCKFB_1_69_COLOR_SCREEN
    bool "Use 1.69 inch color screen"
    select AIC_USING_QSPI3
    default n
    help
        More information is available at: https://wiki.lckfb.com/
```

## application/rt-thread/helloworld/user-bsp/3-5-color-screen/Kconfig
```kconfig
comment "use 3.5 inch st7796 SPI screen"
config LCKFB_3_5_COLOR_SCREEN
    bool "Use 3.5 inch color screen"
    select AIC_USING_QSPI3
    default n
    help
        More information is available at: https://wiki.lckfb.com/
```

## application/rt-thread/helloworld/user-bsp/3-7-color-screen/Kconfig
```kconfig
config LCKFB_3_7_COLOR_SCREEN
    bool "Use 3.7 inch color screen"
    select AIC_USING_QSPI3
    default n
    help
        More information is available at: https://wiki.lckfb.com/
```
